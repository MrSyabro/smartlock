## components/lock_connect/Kconfig.projbuild
```kconfig
menu "WiFi settings"

config WIFI_SSID
    string "WiFi SSID"
    default "myssid"
    help
        SSID (network name) for the example to connect to.

config WIFI_PASSWORD
    string "WiFi Password"
    default "mypassword"
    help
        WiFi password (WPA or WPA2) for the example to use.

endmenu

menu "Broker settings"

config BROKER_URL
    string "Broker URL"
    default "mqtt://iot.eclipse.org"
    help
        URL of the broker to connect to

config BROKER_AUTH
    bool "Authentificate"
    default y
    help
        Authentificate on broker

config BROKER_USER
    string "User"
    default "myusername"
    help
        Username broker

config BROKER_PASS
    string "Password"
    default "mypassword"
    help
        Password broker

config BROKER_URL_FROM_STDIN
    bool
    default y if BROKER_URL = "FROM_STDIN"

endmenu
```
